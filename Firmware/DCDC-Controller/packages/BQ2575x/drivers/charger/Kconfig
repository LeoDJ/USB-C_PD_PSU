## Firmware/DCDC-Controller/packages/BQ2575x/drivers/charger/Kconfig
```kconfig
config CHARGER_BQ2575x
    bool "Enable TI BQ2575x charger support"
    depends on I2C
    help
      Enable support for the TI BQ2575x battery charger.
```

## Firmware/DCDC-Controller/packages/BQ2575x/drivers/i2c/Kconfig
```kconfig
menuconfig I2C_GPIO_EMULATED_OD
    bool "Custom I2C bitbang (GPIO) driver"
    depends on I2C
	  select I2C_BITBANG
    help
      Replace the default GPIO I2C driver with a custom version.

# if I2C_GPIO_EMULATED_OD
# config I2C
#     default y
# endif
```

## Firmware/DCDC-Controller/packages/BQ2575x/dts/bindings/charger/ti,bq2575x.yaml
```yaml
description: |
  BQ2575X

  The device has a single child node for the charger. For example:

  bq2575x@6b {
    compatible = "ti,bq2575x";
    reg = <0x6b>;

    constant-charge-current-max-microamp = <500000>;
  };

compatible: "ti,bq2575x"

include: [battery.yaml, i2c-device.yaml]


properties:
  reg:
    required: true
#   constant-charge-current-max-microamp:
#     type: int
#     default: 0
#     description: |
#       Charge current set at init time in uA, available range is 5 mA to 800 mA.
#       The value specified will be rounded down to the closest implemented
#       value. If set to 0 (default) skip setting the charge current value at
#       driver initialization.
```

## Firmware/DCDC-Controller/packages/BQ2575x/dts/bindings/i2c/gpio-i2c-emod.yaml
```yaml
# Copyright (c) 2020 Vestas Wind Systems A/S
# SPDX-License-Identifier: Apache-2.0

description: GPIO bitbanging I2C support, with emulated open drain behaviour

compatible: "gpio-i2c-emod"

include: i2c-controller.yaml

properties:
  scl-gpios:
    type: phandle-array
    required: true
    description: GPIO to which the SCL pin of the I2C bus is connected.
  sda-gpios:
    type: phandle-array
    required: true
    description: GPIO to which the SDA pin of the I2C bus is connected.
```
